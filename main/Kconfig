## main/Kconfig
```kconfig
menu "Application"

    choice DEVICE_MODEL
        prompt "Device Model"
        default DEVICE_MODEL_LM25
        config DEVICE_MODEL_LB150
            bool "LB150"
        config DEVICE_MODEL_LM25
            bool "LM25"
        config DEVICE_MODEL_LM15
            bool "LM15"
        config DEVICE_MODEL_LM12
            bool "LM12"
        config DEVICE_MODEL_LM30
            bool "LM30"
        config DEVICE_MODEL_LM35
            bool "LM35"
    endchoice

    choice COMPILE_MODEL
        bool "compile model"
        default COMPILE_MODEL_DEBUG
        config COMPILE_MODEL_DEBUG
            bool "compile debug version"
        config COMPILE_MODEL_RELEASE
            bool "compile release version"
            select SECURE_BOOT
            select SECURE_FLASH_ENC_ENABLED
    endchoice

    config HEARTBEAT_PIN
        int "Heartbeat led Pin"
        range 0 33
        default 5
        help
            Heartbeat Pin

    config INDICATOR_1_PIN
        int "indicator led 1 Pin"
        range 0 33
        default 21 if DEVICE_MODEL_LM12
        default 23
        help
            indicator led 1 Pin

    config INDICATOR_2_PIN
        int "indicator led 2 Pin"
        range 0 33
        default 22 if DEVICE_MODEL_LM12
        default 22
        help
            indicator led 2 Pin

    config KEY_PIN
        int "Key Pin"
        range 0 33
        default 23 if DEVICE_MODEL_LM12
        default 21
        help
            Key Pin

    config FAN_SIGNALE_INVERT
        bool "Fan Control Signal Invert"
        default n
        help
            Fan Control Signal Invert

    config FAN_PIN
        int "Fan Control Pin"
        range 0 33
        default 2
        help
            Fan Control Pin

    config LED_WHITE_PIN
        int "White Led Control Pin"
        range 0 33
        default 12 if DEVICE_MODEL_LM30
        default 25
        help
            White Led Control Pin

    config LED_DARK_BLUE_PIN
        int "Dark Blue Led Control Pin"
        range 0 33
        default 26 if DEVICE_MODEL_LM30
        default 27
        help
            Dark Blue Led Control Pin

    config LED_BLUE_PIN
        int "Blue Led Control Pin"
        range 0 33
        default 12 if DEVICE_MODEL_LM12
        default 13
        help
            Blue Led Control Pin

    config LED_RED_PIN
        int "Red Led Control Pin"
        range 0 33
        default 33
        help
            Red Led Control Pin

    config LED_GREEN_PIN
        int "Green Led Control Pin"
        range 0 33
        default 25 if DEVICE_MODEL_LM30
        default 32
        help
            Green Led Control Pin

    config LED_UV_405_PIN
        int "UV 405 Led Control Pin"
        range 0 33
        default 27 if DEVICE_MODEL_LM30
        default 13 if DEVICE_MODEL_LM12
        default 26
        help
            UV 405 Led Control Pin

    config LED_UV_415_PIN
        int "UV 415 Led Control Pin"
        range 0 33
        default 32 if DEVICE_MODEL_LM30
        default 32 if DEVICE_MODEL_LM12
        default 12
        help
            UV 415 Led Control Pin

    config FAN_PWM_FREQ
        int "Fan Pwm Signal Period Freq(Hz)"
        range 10000 64000
        default 32000
        help
            Fan Pwm Signal Period Freq(Hz)

    config FAN_PLAY_MAX
        int "Fan Play MAX Second"
        range 1 65535
        default 600
        help
            Fan Play MAX Second

    config FAN_PWM_MIN
        int "Fan Pwm Output Min Duty"
        range 0 100
        default 10
        help
            Fan Pwm Output Min Duty

    config LED_PWM_MIN
        int "LED Pwm Output Min Duty"
        range 0 1000
        default 10
        help
            Len Pwm Output Min Limit

    config LED_PWM_MAX
        int "LED Pwm Output Max Duty"
        range 0 1000
        default 780 if DEVICE_MODEL_LM15
        default 800 if DEVICE_MODEL_LM12
        default 950 if DEVICE_MODEL_LM30
        default 900
        help
            Len Pwm Output Max
    
endmenu                             
```

## sdkconfig.defaults
```kconfig
# Enable C++ exceptions 
CONFIG_COMPILER_CXX_EXCEPTIONS=n

# Flash size
CONFIG_ESPTOOLPY_FLASHSIZE_4MB=y
# Default sdkconfig parameters to use the OTA
CONFIG_PARTITION_TABLE_CUSTOM=y
CONFIG_PARTITION_TABLE_CUSTOM_FILENAME="partitions.csv"
CONFIG_PARTITION_TABLE_FILENAME="partitions.csv"
CONFIG_PARTITION_TABLE_OFFSET=0x16000
CONFIG_PARTITION_TABLE_MD5=y
# Wifi
CONFIG_ESP32_WIFI_NVS_ENABLED=n
# mdns_start
CONFIG_MDNS_TASK_PRIORITY=4
CONFIG_ESP_NETIF_TCPIP_ADAPTER_COMPATIBLE_LAYER=y
CONFIG_ESP_MAIN_TASK_STACK_SIZE=6144
# WebSocket Server
CONFIG_WEBSOCKET_SERVER_TASK_STACK_DEPTH=8192
CONFIG_WEBSOCKET_SERVER_MAX_CLIENTS=6
CONFIG_WEBSOCKET_SERVER_QUEUE_SIZE=20
CONFIG_WEBSOCKET_SERVER_PINNED=y
CONFIG_WEBSOCKET_SERVER_PINNED_CORE=1
CONFIG_WEBSOCKET_SERVER_TASK_PRIORITY=9
```
